## CMakeLists.txt
```
cmake_minimum_required(VERSION 3.20.0)

find_package(Zephyr REQUIRED HINTS $ENV{ZEPHYR_BASE})
project(6sens_rtos_lora)

FILE(GLOB app_sources src/*.c)
target_sources(app PRIVATE ${app_sources})
```

## prj.conf
```kconfig
# Debugger Support
CONFIG_UART_CONSOLE=n
CONFIG_CONSOLE=y
CONFIG_SERIAL=y

# RTT Segger Support
CONFIG_RTT_CONSOLE=y
CONFIG_USE_SEGGER_RTT=y

# Communication Bus Support
CONFIG_GPIO=y
CONFIG_SPI=y

# LoRa Support
CONFIG_LORA=y

# Random Number Generation Support
CONFIG_TEST_RANDOM_GENERATOR=y
```

## src/main.c
```c
/*
 * Copyright (c) 2025
 * Regis Rousseau
 * Univ Lyon, INSA Lyon, Inria, CITI, EA3720
 * SPDX-License-Identifier: Apache-2.0
 */

//  ========== includes ====================================================================
#include "app_lora.h"

//  ========== globals ====================================================================
// define GPIO configurations for the LED
static const struct gpio_dt_spec led_tx = GPIO_DT_SPEC_GET(LED_TX, gpios);

//  ========== main ========================================================================
int8_t main(void)
{
	// print initial message indicating the program and board name
	printk("LoRa Transmitter Example\nBoard: %s\n", CONFIG_BOARD);
	
	// initialize the LoRa radio device
	const struct device *lora_dev = DEVICE_DT_GET(DT_ALIAS(lora0));
	if (!device_is_ready(lora_dev)) {
		printk("%s: device not ready\n", lora_dev->name);
		return;
	}

	// configure the transmission LED pin as an output
	gpio_pin_configure_dt(&led_tx, GPIO_OUTPUT_ACTIVE);
	gpio_pin_set_dt(&led_tx, 0);

	// configuration of LoRa parameters for transmission 
	if (app_lora_config(lora_dev, TRANSMIT)) {
		printk("LoRa device configured\n");
	} else {
			return 0;
	}

	// main loop for transmitting packets over LoRa
	while (1) {
		// generate a random 32-bit payload (simulating ADC value)
		int32_t payload = sys_rand32_get();

		// transmit the payload using LoRa
		int8_t ret = lora_send(lora_dev, &payload, sizeof(payload));
		if (ret == 0) {
			printk("LoRa send failed. error %d\n", ret);
			return 0;
		} else {
			// toggle the transmission LED to indicate successful transmission
			ret = gpio_pin_toggle_dt(&led_tx);	 
			if (ret < 0) {
				return 0;
			}
			
			// print details about the transmitted data
			printk("transmitted value: %d\n", payload);
		}
		// wait for a specified interval before transmitting the next packet
		k_msleep(SLEEP_TIME_MS);;	
	}
	return 0;
}
```

## src/app_lora.c
```c
/*
 * Copyright (c) 2025
 * Regis Rousseau
 * Univ Lyon, INSA Lyon, Inria, CITI, EA3720
 * SPDX-License-Identifier: Apache-2.0
 */

//  ========== includes ====================================================================
#include "app_lora.h"

//  ========== app_lora_config =============================================================
int8_t app_lora_config(const struct device *dev, bool TxRx)
{
	int8_t ret;
	struct lora_modem_config config;

	// configure lora phy layer parameters
	config.frequency = 868100000;
	config.bandwidth = BW_125_KHZ;
	config.datarate = SF_9;
	config.preamble_len = 8;
	config.coding_rate = CR_4_5;
	config.tx_power = 17;
	config.iq_inverted = false;
	config.public_network = false;
	config.tx = TxRx;

	// apply the configuration to the LoRa device
	ret = lora_config(dev, &config);
	if (ret < 0) {
		printk("lora device configuration failed. error: %d\n", ret);
		return 0;
	}
	return 1;
}
```

## src/app_lora.h
```c
/*
 * Copyright (c) 2025
 * Regis Rousseau
 * Univ Lyon, INSA Lyon, Inria, CITI, EA3720
 * SPDX-License-Identifier: Apache-2.0
 */

#ifndef APP_LORA_H
#define APP_LORA_H

//  ========== includes ====================================================================
#include <zephyr/device.h>
#include <zephyr/kernel.h>
#include <zephyr/drivers/lora.h>
#include <zephyr/drivers/gpio.h>
#include <zephyr/random/random.h>

//  ========== defines =====================================================================
#define TRANSMIT        1
#define RECEIVE         0
#define LED_TX          DT_ALIAS(led0)
#define SLEEP_TIME_MS   2000            // like zephyr lora driver sample

//  ========== prototypes ==================================================================
int8_t app_lora_config(const struct device *dev, bool TxRx);

#endif /* APP_LORA_H */
```
